## main/Kconfig.projbuild
```kconfig
menu "ESP32 IPphone"

    menu "Keypad pins"
        config IPPHONE_KEYPAD_ROW0
            int "Keypad row 0 GPIO"
            default 13
        config IPPHONE_KEYPAD_ROW1
            int "Keypad row 1 GPIO"
            default 12
        config IPPHONE_KEYPAD_ROW2
            int "Keypad row 2 GPIO"
            default 14
        config IPPHONE_KEYPAD_ROW3
            int "Keypad row 3 GPIO"
            default 27
        config IPPHONE_KEYPAD_COL0
            int "Keypad column 0 GPIO"
            default 26
        config IPPHONE_KEYPAD_COL1
            int "Keypad column 1 GPIO"
            default 25
        config IPPHONE_KEYPAD_COL2
            int "Keypad column 2 GPIO"
            default 33
        config IPPHONE_KEYPAD_COL3
            int "Keypad column 3 GPIO"
            default 32
    endmenu

    menu "I2S audio pins"
        config IPPHONE_I2S_MIC_BCLK
            int "Microphone I2S SCK/BCLK GPIO"
            default 18
        config IPPHONE_I2S_MIC_WS
            int "Microphone I2S WS GPIO"
            default 19
        config IPPHONE_I2S_MIC_DIN
            int "Microphone I2S data in GPIO"
            default 23
        config IPPHONE_I2S_SPK_BCLK
            int "Speaker amp I2S BCLK GPIO"
            default 5
        config IPPHONE_I2S_SPK_WS
            int "Speaker amp I2S LRC/LRCLK GPIO"
            default 17
        config IPPHONE_I2S_SPK_DOUT
            int "Speaker amp I2S data out GPIO"
            default 22
        config IPPHONE_I2S_SAMPLE_RATE
            int "I2S sample rate"
            default 16000
    endmenu

    menu "Display pins"
        config IPPHONE_I2C_SDA
            int "I2C SDA GPIO"
            default 21
        config IPPHONE_I2C_SCL
            int "I2C SCL GPIO"
            default 4
    endmenu

endmenu
```

## sdkconfig.defaults
```kconfig
CONFIG_IDF_TARGET="esp32"
CONFIG_ESP_MAIN_TASK_STACK_SIZE=6144
CONFIG_LOG_DEFAULT_LEVEL_INFO=y
CONFIG_FREERTOS_HZ=1000

# Project hardware defaults. Change with: idf.py menuconfig
CONFIG_IPPHONE_BOOT_BUTTON_GPIO=0

CONFIG_IPPHONE_KEYPAD_ROW0=13
CONFIG_IPPHONE_KEYPAD_ROW1=12
CONFIG_IPPHONE_KEYPAD_ROW2=14
CONFIG_IPPHONE_KEYPAD_ROW3=27
CONFIG_IPPHONE_KEYPAD_COL0=26
CONFIG_IPPHONE_KEYPAD_COL1=25
CONFIG_IPPHONE_KEYPAD_COL2=33
CONFIG_IPPHONE_KEYPAD_COL3=32

CONFIG_IPPHONE_I2S_MIC_BCLK=18
CONFIG_IPPHONE_I2S_MIC_WS=19
CONFIG_IPPHONE_I2S_MIC_DIN=23
CONFIG_IPPHONE_I2S_SPK_BCLK=5
CONFIG_IPPHONE_I2S_SPK_WS=17
CONFIG_IPPHONE_I2S_SPK_DOUT=22
CONFIG_IPPHONE_I2S_SAMPLE_RATE=16000

CONFIG_IPPHONE_I2C_SDA=21
CONFIG_IPPHONE_I2C_SCL=4

CONFIG_IPPHONE_LED_GREEN_GPIO=2
CONFIG_IPPHONE_LED_GREEN_ACTIVE_LEVEL=1
CONFIG_IPPHONE_LED_RED_GPIO=16
CONFIG_IPPHONE_LED_RED_ACTIVE_LEVEL=1
```
